## Config.in
```kconfig
if PACKAGE_flashman-plugin

choice
	prompt "Customer image choice"
	default USE_DEFAULT_FLAG
	help
		Select desired files target that will be applied to FlashMan plugin.
	config USE_DEFAULT_FLAG
		bool "default"
endchoice

config FLASHMAN_KEYS_PATH
	string "Public key file path. This key will be used for remote SSH access."
	default "/home/localuser/.ssh"

config FLASHMAN_PUBKEY_FNAME
	string "Public key file name. This key will be used for remote SSH access."
	default "id_rsa.pub"

config PROVIDER_PUBKEY_FNAME
	string "Provider Public key file name. This key will be used to authorize lua access."
	default "provider.pubkey"

config FLASHMAN_SERVER_ADDR
	string "Flashman server IP or FQDN"
	default ""

choice
	prompt "WiFi AP SSID Suffix"
	default FLASHMAN_SSID_SUFFIX_LASTMAC
	help
		Select a suffix value to append in the WiFi SSID.
	config FLASHMAN_SSID_SUFFIX_NONE
		bool "None"
	config FLASHMAN_SSID_SUFFIX_LASTMAC
		bool "Last four chars from MAC address"
endchoice

config FLASHMAN_WIFI_SSID
	string "WiFi AP SSID Prefix."
	default "FlashMan-AP-"

config FLASHMAN_WIFI_PASSWD
	string "WiFi router AP password. If blank router mac address will be used. Remember to escape hashtags and dollar signs with a slash."
	default ""

config FLASHMAN_WIFI_CHANNEL
	string "WiFi router AP 2.4GHz channel."
	default "auto"

config FLASHMAN_WIFI_BAND
	string "WiFi router AP 2.4GHz bandwidth."
	default "HT40"

config FLASHMAN_WIFI_5GHZ_CHANNEL
	string "WiFi router AP 5.0GHz channel."
	default "auto"

config FLASHMAN_WIFI_DISASSOC_LOW_ACK
	string "Disassociate devices with frequent ACK loss (poor signal)"
	default "1"

config FLASHMAN_RELEASE_ID
	string "FlashMan image release identification"
	default "0000-flm"

config FLASHMAN_CLIENT_ORG
	string "FlashMan image client organization identification"
	default "MyCompany"

config NTP_SERVER_ADDR
	string "First NTP server IP or FQDN"
	default "a.st1.ntp.br"

config NTP_SERVER_ADDR_2
	string "Second NTP server IP or FQDN"
	default "b.st1.ntp.br"

config NTP_SERVER_ADDR_3
	string "Third NTP server IP or FQDN"
	default "c.st1.ntp.br"

config NTP_SERVER_ADDR_4
	string "Fourth NTP server IP or FQDN"
	default "d.st1.ntp.br"

choice
	prompt "WAN connection protocol"
	default FLASHMAN_WAN_PROTO_DHCP
	help
		Select which protocol will be used on the WAN interface.
	config FLASHMAN_WAN_PROTO_DHCP
		bool "DHCP"
	config FLASHMAN_WAN_PROTO_PPPOE
		bool "PPPoE"
endchoice

config FLASHMAN_PPPOE_USER
	string "PPPoE username. Remember to escape hashtags and dollar signs with a slash."
	default "flashman-user"

config FLASHMAN_PPPOE_PASSWD
	string "PPPoE password. Remember to escape hashtags and dollar signs with a slash."
	default "Flashman!"

config FLASHMAN_PPPOE_SERVICE
	string "PPPoE service. Remember to escape hashtags and dollar signs with a slash."
	default "auto"

config FLASHMAN_WAN_MTU
	string "WAN MTU"
	default "1500"

config FLASHMAN_WAN_IPV6_ENABLED
	bool "Enable IPv6 on WAN"
	default y

config FLASHMAN_LAN_SUBNET
	string "LAN subnet gateway"
	default "10.0.10.0"

config FLASHMAN_LAN_NETMASK
	string "LAN netmask"
	default "24"

config FLASHMAN_LAN_IPV6_PREFIX
	string "LAN ÏPV6 Prefix for Prefix Delegation"
	default "64"

config FLASHMAN_DHCP_NOPROXY
	string "Do not use router as a DNS proxy"
	default "0"

config MQTT_PORT
	string "MQTT port"
	default "1883"

config FLASHMAN_USE_AUTH_SERVER
	bool "Use authentication server to authorize remote commands."

if FLASHMAN_USE_AUTH_SERVER
	config FLASHMAN_AUTH_SERVER_ADDR
		string "Authentication server IP or FQDN"
		default ""
	config FLASHMAN_CLIENT_SECRET
		string "Shared secret to authorize this image"
		default ""
endif

endif
```

## flashman-plugin/Config.in
```kconfig
if PACKAGE_flashman-plugin

choice
	prompt "Customer image choice"
	default USE_DEFAULT_FLAG
	help
		Select desired files target that will be applied to FlashMan plugin.
	config USE_DEFAULT_FLAG
		bool "default"
endchoice

config FLASHMAN_KEYS_PATH
	string "Public key file path. This key will be used for remote SSH access."
	default "/home/localuser/.ssh"

config FLASHMAN_PUBKEY_FNAME
	string "Public key file name. This key will be used for remote SSH access."
	default "id_rsa.pub"

config FLASHMAN_SERVER_ADDR
	string "Flashman server IP or FQDN"
	default ""

config FLASHMAN_WIFI_SSID
	string "WiFi AP SSID prefix. This will be appended by the last mac address 4 characters"
	default "FlashMan-AP-"

config FLASHMAN_WIFI_PASSWD
	string "WiFi router AP password. Leave it blank and router mac address will be used. Remember to escape hashtags and dollar signs with a slash."
	default ""

config FLASHMAN_WIFI_CHANNEL
	string "WiFi router AP 2.4GHz channel."
	default "auto"

config FLASHMAN_RELEASE_ID
	string "FlashMan image release identification"
	default "0000-flm"

config ZABBIX_SERVER_ADDR
	string "Zabbix server IP or FQDN"
	default ""

config NTP_SERVER_ADDR
	string "NTP server IP or FQDN"
	default "a.st1.ntp.br"

choice
	prompt "WAN connection protocol"
	default FLASHMAN_WAN_PROTO_DHCP
	help
		Select which protocol will be used on the WAN interface.
	config FLASHMAN_WAN_PROTO_DHCP
		bool "DHCP"
	config FLASHMAN_WAN_PROTO_PPPOE
		bool "PPPoE"
endchoice

if FLASHMAN_WAN_PROTO_PPPOE
	config FLASHMAN_PPPOE_USER
		string "PPPoE username. Remember to escape hashtags and dollar signs with a slash."
		default "flashman-user"

	config FLASHMAN_PPPOE_PASSWD
		string "PPPoE password. Remember to escape hashtags and dollar signs with a slash."
		default "Flashman!"

	config FLASHMAN_PPPOE_SERVICE
		string "PPPoE service. Remember to escape hashtags and dollar signs with a slash."
		default "auto"
endif

config FLASHMAN_WAN_MTU
	string "WAN MTU"
	default "1500"

endif
```
